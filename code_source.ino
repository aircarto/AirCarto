/**************************************************************************
  Projet AirCarto
  
  Ecran 1.8'' 128x160 rgb_tft
  5V!!!
  SCL -> D52
  SDA -> D51
  RST -> D7
  DC -> D9
  CS -> D11

  SDS011 sur Serial 2 (5V)
  TX -> D15
  
  GPS sur SERIAL 3 (5V)
  TX -> D17
  
  BME280 connexion sur MEGA SDA>D20 et SCL>D21 alim 3v

  CCS811 
  Alim 3,3V nécessite un temps d'adaptation (24/48H)
  SDA->D20
  SCL->D21
  WAK->GND

  module carte SD (en 5V)
  MISO->D50
  MOSI->D51
  SCK->D52
  CS->D53
  

 Paul Vuarambon
 11 novembre 2019

 This program is free software: you can redistribute it and/or modify
    it under the terms of the GNU General Public License as published by
    the Free Software Foundation, either version 3 of the License, or
    (at your option) any later version.

    This program is distributed in the hope that it will be useful,
    but WITHOUT ANY WARRANTY; without even the implied warranty of
    MERCHANTABILITY or FITNESS FOR A PARTICULAR PURPOSE.  See the
    GNU General Public License for more details.

    You should have received a copy of the GNU General Public License
    along with this program.  If not, see <https://www.gnu.org/licenses/>.
 **************************************************************************/

//setup screen
#include <Adafruit_GFX.h>    // Core graphics library
#include <Adafruit_ST7735.h> // Hardware-specific library for ST7735
#include <Adafruit_ST7789.h> // Hardware-specific library for ST7789
#include <SPI.h>

#define TFT_CS        11
#define TFT_RST        7 // Or set to -1 and connect to Arduino RESET pin
#define TFT_DC         9
  
Adafruit_ST7735 tft = Adafruit_ST7735(TFT_CS, TFT_DC, TFT_RST);

//setup SDS011
#include <SDS011-select-serial.h>
float p10,p25;
int error;
SDS011 my_sds(Serial2);

//setup BME280
#include <Wire.h>
#include <Adafruit_Sensor.h>
#include <Adafruit_BME280.h>
#define SEALEVELPRESSURE_HPA (1013.25)
Adafruit_BME280 bme;

//setup CCS811
#include "Adafruit_CCS811.h"
Adafruit_CCS811 ccs;

//pour le GPS on utilise la Librairie TinyGPS++
#include <TinyGPS++.h>
TinyGPSPlus tinyGPS;
HardwareSerial & ss = Serial3;

//setup pour le module carte SD
#include <SD.h>
File myFile;

#include <math.h>

//variable pour dessiner les lignes
int placeX = 41;

//LOGO **********************

const unsigned char logoAircarto [] PROGMEM = {
0x00, 0x00, 0x00, 0x00, 0x00, 0x00, 0x00, 0x00, 0x00, 0x00, 0x00, 0x00, 0x00, 0x00, 0x00, 0x00, 0x00, 0x00, 0x00, 0x00, 0x00, 0x00, 0x00, 0x00, 0x00, 0x00, 0x00, 0x00, 0x00, 0x00, 0x00, 0x00, 
0x00, 0x00, 0x00, 0x00, 0x00, 0x00, 0x00, 0x00, 0x00, 0x00, 0x00, 0x00, 0x00, 0x00, 0x00, 0x00, 0x00, 0x00, 0x00, 0x00, 0x00, 0x00, 0x00, 0x00, 0x00, 0x00, 0x00, 0x00, 0x00, 0x00, 0x00, 0x00, 
0x00, 0x00, 0x00, 0x00, 0x00, 0x00, 0x00, 0x00, 0x00, 0x00, 0x00, 0x00, 0x00, 0x00, 0x00, 0x00, 0x00, 0x00, 0x00, 0x00, 0x00, 0x00, 0x00, 0x00, 0x00, 0x00, 0x00, 0x00, 0x00, 0x00, 0x00, 0x00, 
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  0x00, 0x00, 0x00, 0x00, 0x00, 0x00, 0x00, 0x00, 0x00, 0x00, 0x00, 0x00, 0x00, 0x00, 0x00, 0x00, 0x00, 0x00, 0x00, 0x00, 0x00, 0x00, 0x00, 0x00, 0x00, 0x00, 0x00, 0x00, 0x00, 0x00, 0x00, 0x00

};

const unsigned char logoCAN_yellow []PROGMEM ={
0x00, 0x00, 0x00, 0x00, 0x00, 0x00, 0x00, 0x00, 0x00, 0x00, 0x00, 0x00, 0x00, 0x00, 0x00, 0x00, 
0x00, 0x00, 0x00, 0x00, 0x00, 0x00, 0x00, 0x00, 0x00, 0x00, 0x00, 0x00, 0x00, 0x00, 0x00, 0x00, 
0x00, 0x00, 0x00, 0x00, 0x00, 0x00, 0x00, 0x7f, 0xfe, 0x00, 0x00, 0x00, 0x00, 0x00, 0x00, 0x00, 
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0x00, 0x00, 0x00, 0x00, 0x00, 0x00, 0x00, 0x00, 0x00, 0x00, 0x00, 0x00, 0x00, 0x00, 0x00, 0x00
};

const unsigned char logoCAN_green []PROGMEM ={
  0x00, 0x00, 0x00, 0x00, 0x00, 0x00, 0x00, 0x00, 0x00, 0x00, 0x00, 0x00, 0x00, 0x00, 0x00, 0x00, 
0x00, 0x00, 0x00, 0x00, 0x00, 0x00, 0x00, 0x00, 0x00, 0x00, 0x00, 0x00, 0x00, 0x00, 0x00, 0x00, 
0x00, 0x00, 0x00, 0x00, 0x00, 0x00, 0x00, 0x00, 0x00, 0x00, 0x00, 0x00, 0x00, 0x00, 0x00, 0x00, 
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0x00, 0x00, 0x00, 0x00, 0x00, 0x00, 0x00, 0x00, 0x00, 0x00, 0x00, 0x00, 0x00, 0x00, 0x00, 0x00
  };

const unsigned char logoCAN_red []PROGMEM ={
  0x00, 0x00, 0x00, 0x00, 0x00, 0x00, 0x00, 0x00, 0x00, 0x00, 0x00, 0x00, 0x00, 0x00, 0x00, 0x00, 
0x00, 0x00, 0x00, 0x00, 0x00, 0x00, 0x00, 0x00, 0x00, 0x00, 0x00, 0x00, 0x00, 0x00, 0x00, 0x00, 
0x00, 0x00, 0x00, 0x00, 0x00, 0x00, 0x00, 0x00, 0x00, 0x00, 0x00, 0x00, 0x00, 0x00, 0x00, 0x00, 
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0x00, 0x00, 0x00, 0x00, 0x00, 0x00, 0x00, 0x00, 0x00, 0x00, 0x00, 0x00, 0x00, 0x00, 0x00, 0x00
};

const unsigned char logoFNE []PROGMEM ={
0x00, 0x00, 0x00, 0x00, 0x00, 0x00, 0x00, 0x00, 0x00, 0x00, 0x00, 0x00, 0x00, 0x00, 0x00, 0x00, 
0x00, 0x00, 0x00, 0x00, 0x00, 0x00, 0x00, 0x00, 0x00, 0x00, 0x00, 0x00, 0x00, 0x00, 0x00, 0x00, 
0x00, 0x00, 0x00, 0x00, 0x00, 0x00, 0x00, 0x00, 0x00, 0x00, 0x00, 0x00, 0x00, 0x00, 0x00, 0x00, 
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0x00, 0x00, 0x00, 0x00, 0x00, 0x00, 0x00, 0x00, 0x00, 0x00, 0x00, 0x00, 0x00, 0x00, 0x00, 0x00
};

const unsigned char logoBattery_full [] PROGMEM = {
  // 'battery_full, 24x17px
  0x00, 0x00, 0x00, 0x00, 0x00, 0x00, 0x7f, 0xff, 0xf8, 0x7f, 0xff, 0xf8, 0x61, 0x86, 0x18, 0x61, 
  0x86, 0x18, 0x61, 0x86, 0x18, 0x61, 0x86, 0x1e, 0x61, 0x86, 0x1e, 0x61, 0x86, 0x1e, 0x61, 0x86, 
  0x18, 0x61, 0x86, 0x18, 0x61, 0x86, 0x18, 0x7f, 0xff, 0xf8, 0x7f, 0xff, 0xf8, 0x00, 0x00, 0x00, 
  0x00, 0x00, 0x00
};

const unsigned char logoBattery_mid [] PROGMEM = {
  // 'battery_mid, 24x17px
  0x00, 0x00, 0x00, 0x00, 0x00, 0x00, 0x7f, 0xff, 0xf8, 0x7f, 0xff, 0xf8, 0x61, 0x87, 0xf8, 0x61, 
  0x87, 0xf8, 0x61, 0x87, 0xf8, 0x61, 0x87, 0xfe, 0x61, 0x87, 0xfe, 0x61, 0x87, 0xfe, 0x61, 0x87, 
  0xf8, 0x61, 0x87, 0xf8, 0x61, 0x87, 0xf8, 0x7f, 0xff, 0xf8, 0x7f, 0xff, 0xf8, 0x00, 0x00, 0x00, 
  0x00, 0x00, 0x00
};

const unsigned char logoBattery_low [] PROGMEM = {
  // 'battery_low, 24x17px
  0x00, 0x00, 0x00, 0x00, 0x00, 0x00, 0x7f, 0xff, 0xf8, 0x7f, 0xff, 0xf8, 0x61, 0xff, 0xf8, 0x61, 
  0xff, 0xf8, 0x61, 0xff, 0xf8, 0x61, 0xff, 0xfe, 0x61, 0xff, 0xfe, 0x61, 0xff, 0xfe, 0x61, 0xff, 
  0xf8, 0x61, 0xff, 0xf8, 0x61, 0xff, 0xf8, 0x7f, 0xff, 0xf8, 0x7f, 0xff, 0xf8, 0x00, 0x00, 0x00, 
  0x00, 0x00, 0x00
};

const unsigned char logoSignal_low [] PROGMEM = {
  // 'signal_low, 18x18px
  0x00, 0x00, 0x00, 0x00, 0x00, 0x00, 0x00, 0x00, 0x00, 0x00, 0x00, 0x00, 0x00, 0x00, 0x00, 0x00, 
  0x00, 0x00, 0x00, 0x00, 0x00, 0x00, 0x00, 0x00, 0x00, 0x00, 0x00, 0x00, 0x00, 0x00, 0x78, 0x00, 
  0x00, 0x78, 0x00, 0x00, 0x78, 0x00, 0x00, 0x78, 0x00, 0x00, 0x00, 0x00, 0x00, 0x79, 0xe7, 0x80, 
  0x79, 0xe7, 0x80, 0x00, 0x00, 0x00
};

const unsigned char logoSignal_mid [] PROGMEM = {
  // 'signal_mid, 18x18px
  0x00, 0x00, 0x00, 0x00, 0x00, 0x00, 0x00, 0x00, 0x00, 0x00, 0x00, 0x00, 0x00, 0x00, 0x00, 0x00, 
  0x00, 0x00, 0x01, 0xe0, 0x00, 0x01, 0xe0, 0x00, 0x01, 0xe0, 0x00, 0x01, 0xe0, 0x00, 0x79, 0xe0, 
  0x00, 0x79, 0xe0, 0x00, 0x79, 0xe0, 0x00, 0x79, 0xe0, 0x00, 0x00, 0x00, 0x00, 0x79, 0xe7, 0x80, 
  0x79, 0xe7, 0x80, 0x00, 0x00, 0x00
};

const unsigned char logoSignal_full [] PROGMEM = {
  // 'signal_full, 18x18px
  0x00, 0x00, 0x00, 0x00, 0x07, 0x80, 0x00, 0x07, 0x80, 0x00, 0x07, 0x80, 0x00, 0x07, 0x80, 0x00, 
  0x07, 0x80, 0x01, 0xe7, 0x80, 0x01, 0xe7, 0x80, 0x01, 0xe7, 0x80, 0x01, 0xe7, 0x80, 0x79, 0xe7, 
  0x80, 0x79, 0xe7, 0x80, 0x79, 0xe7, 0x80, 0x79, 0xe7, 0x80, 0x00, 0x00, 0x00, 0x79, 0xe7, 0x80, 
  0x79, 0xe7, 0x80, 0x00, 0x00, 0x00
};

const unsigned char logoDiams [] PROGMEM = {
  0x00, 0x00, 0x00, 0x00, 0x00, 0x00, 0x00, 0x00, 0x00, 0x00, 0x00, 0x00, 0x00, 0x00, 0x00, 0x00, 
  0x00, 0x00, 0x00, 0x00, 0x00, 0x00, 0x00, 0x00, 0x00, 0x00, 0x00, 0x00, 0x00, 0x00, 0x00, 0x00, 
  0x00, 0x00, 0x00, 0x00, 0x00, 0x00, 0x00, 0x00, 0x00, 0x00, 0x00, 0x00, 0x00, 0x00, 0x00, 0x00, 
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  0x00, 0x00, 0x00, 0x00, 0x00, 0x00, 0x00, 0x00, 0x00, 0x00, 0x00, 0x00, 0x00, 0x00, 0x00, 0x00
};

void setup(void) {
  Serial.begin(9600);
  Serial2.begin(9600);              //départ SDS011
  tft.initR(INITR_BLACKTAB);        // départ screen
  bme.begin(0x76);                  //départ BME280
  ccs.begin();                      //départ ccs811
  ss.begin(9600);                   //départ GPS
  SD.begin(53);                     //départ module SD

  //calibrate temperature sensor
  while(!ccs.available());
  float temp = ccs.calculateTemperature();
  ccs.setTempOffset(temp - 25.0);

  tft.fillScreen(ST77XX_BLACK);
  

  //logo AIRCARTO ******************************************
  
  tft.drawBitmap(0, 0, logoAircarto, 128, 127, ST77XX_BLUE);
  delay(500);
  tft.setCursor(0,125);
  tft.setTextWrap(false);
  tft.setTextColor(ST77XX_WHITE);
  tft.setTextSize(1);
  tft.println("   Capteur mobile de ");
  tft.println("       pollution     ");
  tft.println("     atmospherique    ");
  delay(5000);

  //logo DIAMS ******************************************

  /*
  tft.fillScreen(ST77XX_BLACK);
  tft.drawBitmap(0, 0, logoDiams, 128, 160, ST77XX_BLUE);
  tft.setCursor(6,125);
  tft.setTextWrap(false);
  tft.setTextColor(ST77XX_WHITE);
  tft.setTextSize(4);
  tft.println("DIAMS");
  delay(3000);
  */


  //logo CAN ******************************************
  
  tft.fillScreen(ST77XX_BLACK);
  tft.drawBitmap(0, 0, logoCAN_yellow, 128, 128, ST77XX_YELLOW);
  tft.drawBitmap(0, 0, logoCAN_green, 128, 128, ST77XX_GREEN);
  tft.drawBitmap(0, 0, logoCAN_red, 128, 128, ST77XX_RED);
  tft.setCursor(0,130);
  tft.setTextWrap(false);
  tft.setTextColor(ST77XX_WHITE);
  tft.setTextSize(1);
  tft.println(" En association avec");
  tft.println("le CAN Environnement");
  delay(3000);

  //logo FNE ******************************************

  tft.fillScreen(ST77XX_BLACK);
  tft.drawBitmap(0, 0, logoFNE, 128, 128, ST77XX_RED);
  tft.setTextWrap(false);
  tft.setTextColor(ST77XX_WHITE);
  tft.setTextSize(1);
  tft.setCursor(0,120);
  tft.println("         et     ");
  tft.println("    France Nature ");
  tft.println("    Environnement");
  tft.println("   Bouches du Rhone");
  delay(3000);

  //vérification SD
  
   tft.fillScreen(ST77XX_BLACK);
   tft.setTextWrap(false);
   tft.setTextColor(ST77XX_WHITE);
   tft.setTextSize(1);
   tft.setCursor(0,0);
   tft.println("Test carte SD:");
   delay(500);
   tft.println("...");
   delay(500);
   tft.println("...");

  
  delay(500);
  if (SD.exists("DATA.txt")) {
    tft.println("fichier DATA.txt");
    delay(500);
    tft.println("...");
    tft.println("OK");

  } else {
    tft.println("Fichier non trouve");
    delay(500);
    tft.println("Verifier carte SD");

  }

  
  delay(2000);
  tft.fillScreen(ST77XX_BLACK);
  
  myFile = SD.open("DATA.txt", FILE_WRITE); //ATTENTION ne pas utiliser de majuscule dans le nom du fichier
  myFile.println("Batterie,PM2.5, PM10,CO2, COV, Temp, Hum,Latitude, Longitude,Jour, Mois, Année, HH:MM:SS");
  myFile.close();
  

 
}

void loop() {
  tft.setCursor(0,0);
  tft.setTextWrap(false);
  //tft.fillScreen(ST77XX_BLACK);
  myFile = SD.open("DATA.txt", FILE_WRITE);

  //création lignes
  /*
  tft.drawLine(0,20, 128,20, ST77XX_WHITE);
  tft.drawLine(0,67, 128,67, ST77XX_WHITE);
  tft.drawLine(0,114, 128,114, ST77XX_WHITE);

  tft.drawLine(40,20, 40,160, ST77XX_WHITE);
  */

  //création carrés
  
  tft.fillRect(35,0,60,16,ST77XX_BLACK);
  
  tft.fillRect(0,30,50,16,ST77XX_BLACK);
  tft.fillRect(0,78,50,16,ST77XX_BLACK);
  tft.fillRect(0,125,50,16,ST77XX_BLACK);



// ******* INFO TOP : SIGNAL GPS et BATTERIE*******************************

  if (tinyGPS.satellites.value()==0){
      tft.drawBitmap(0, 0, logoSignal_low, 18, 18, ST77XX_WHITE);
  }
  else if (tinyGPS.satellites.value()<=3){
      tft.drawBitmap(0, 0, logoSignal_mid, 18, 18, ST77XX_WHITE);
  }
  else {
          tft.drawBitmap(0, 0, logoSignal_full, 18, 18, ST77XX_WHITE);
  }
  
  tft.setTextColor(ST77XX_WHITE);
  tft.setTextSize(1);
  tft.setCursor(40, 0);
  
  tft.print(tinyGPS.time.hour());
  tft.print(":" );
  tft.print(tinyGPS.time.minute());
  tft.print(":" );
  tft.print(tinyGPS.time.second());
  tft.print("  " );

  int sensorValue = analogRead(A4);
  // Convert the analog reading (which goes from 0 - 1023) to a voltage (0 - 5V):
  float voltage = sensorValue * (5.0 / 1023.0);
  tft.setCursor(40, 8);
  tft.println(voltage);
  //état de la batterie, logo en haut à droite
  if (voltage >= 3.5){
    tft.drawBitmap(103, 0, logoBattery_full, 24, 17, ST77XX_WHITE);
  }
  else if (voltage >= 3.0)
  {
    tft.drawBitmap(103, 0, logoBattery_mid, 25, 17, ST77XX_WHITE);
  }
  else {
    tft.drawBitmap(103, 0, logoBattery_low, 25, 17, ST77XX_WHITE);
  }
  
 
  myFile.print(voltage);
  myFile.print(",");

// ******* PARTICULES FINES*******************************

  error = my_sds.read(&p25,&p10);
  if (! error) {

    tft.setTextColor(ST77XX_RED);
    tft.setTextSize(1);
    tft.setCursor(0,23);

    
    tft.println("PM2.5:");
    tft.setTextSize(2);
    tft.println(p25,0);
    tft.setTextSize(1);
    tft.println("ugm/3");

    //cération du graphique 

     if (p25<88){
      tft.drawLine(placeX,64, placeX,64-(p25/2), ST77XX_RED);
     }
     else {
     tft.drawLine(placeX,64, placeX,20, ST77XX_RED);   
     }
     
    /*
    tft.print("PM10: "+String(p10));
    tft.println("ugm/3");
    */

    myFile.print(String(p25));
    myFile.print(",");
    myFile.print(String(p10));
    myFile.print(",");
 
  }

// ******* C02 et COV *******************************

  if(ccs.available()){
    float temp = ccs.calculateTemperature();
    if(!ccs.readData()){
    
      tft.setTextColor(ST77XX_GREEN);
      tft.setCursor(0,70);

      tft.println("CO2: ");
      tft.setTextSize(2);
      tft.println(ccs.geteCO2());
      tft.setTextSize(1);
      tft.println("ppm");

      //graphique CO2

      tft.drawLine(placeX,110, placeX,110-((ccs.geteCO2()-400)/120), ST77XX_GREEN);

     
      tft.setTextColor(ST77XX_YELLOW);
      tft.setCursor(0,118);
      
      tft.println("TVOC: ");
      tft.setTextSize(2);
      tft.println(ccs.getTVOC());
      tft.setTextSize(1);
      tft.println("ppb");

      //graphique VOC

      tft.drawLine(placeX,156, placeX,156-((ccs.getTVOC())/50), ST77XX_YELLOW);
      
      tft.drawLine(placeX+1,156, placeX+1,21, ST77XX_BLACK);    
      tft.drawLine(placeX+2,156, placeX+2,21, ST77XX_BLACK);
      tft.drawLine(placeX+3,156, placeX+3,21, ST77XX_BLACK);
      tft.drawLine(placeX+4,156, placeX+4,21, ST77XX_BLACK);
      
      //tft.print("Temp:");
      //tft.println(temp);

      myFile.print(ccs.geteCO2());
      myFile.print(",");
      myFile.print(ccs.getTVOC());
      myFile.print(",");
    }
    }
    
// ******* TEMPERATURE Et HUMIDITE *******************************

/*
  tft.setTextColor(ST77XX_YELLOW);
  tft.print("Temp: ");
  tft.print(bme.readTemperature());
  tft.println("*C");

  tft.print("Hum: ");
  tft.print(bme.readHumidity());
  tft.println("%");
*/

  myFile.print(bme.readTemperature());
  myFile.print(",");
  myFile.print(bme.readHumidity());
  myFile.print(",");

// ******* GPS *******************************

  /*
  tft.setTextColor(ST77XX_BLUE);
  tft.print("GPS:");
  tft.print(tinyGPS.satellites.value());
  tft.println(" sat");
 
  tft.setTextSize(1);
  tft.println("Lat/Long: "); 
  tft.print(tinyGPS.location.lat(), 6);
  tft.print("  ");
  tft.println(tinyGPS.location.lng(), 6);
  */

  myFile.print(tinyGPS.location.lat(),6);
  myFile.print(",");
  myFile.print(tinyGPS.location.lng(),6);
  myFile.print(",");
 
  myFile.print(tinyGPS.date.day());
  myFile.print(",");
  myFile.print(tinyGPS.date.month());
  myFile.print(",");
  myFile.print(tinyGPS.date.year());
  myFile.print(",");

  myFile.print(tinyGPS.time.hour());
  myFile.print(":");
  myFile.print(tinyGPS.time.minute());
  myFile.print(":");
  myFile.println(tinyGPS.time.second());
  

//fermeture fichier SD
  myFile.close();
  
// ******* DELAY *******************************

smartDelay(2000);

placeX = placeX + 1;
if (placeX >= 128){
  placeX=41;
}
}


static void smartDelay(unsigned long ms)
{
  unsigned long start = millis();
  do
  {
    while (ss.available())
      tinyGPS.encode(ss.read());
  } while (millis() - start < ms);
}
